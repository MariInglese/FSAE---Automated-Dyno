VERSION ""

NS_ :

BS_:

BU_:

BO_ 1 HARDINJ_command: 8 Vector__XXX
 SG_ HARDINJ_output6Control m0 : 55|8@0+ (1,0) [0.0|255.0] "" Vector__XXX
 SG_ HARDINJ_output5Control m0 : 47|8@0+ (1,0) [0.0|255.0] "" Vector__XXX
 SG_ HARDINJ_output4Control m0 : 39|8@0+ (1,0) [0.0|255.0] "" Vector__XXX
 SG_ HARDINJ_output3Control m0 : 31|8@0+ (1,0) [0.0|255.0] "" Vector__XXX
 SG_ HARDINJ_output2Control m0 : 23|8@0+ (1,0) [0.0|255.0] "" Vector__XXX
 SG_ HARDINJ_output1Control m0 : 15|8@0+ (1,0) [0.0|255.0] "" Vector__XXX
 SG_ HARDINJ_mux M : 7|8@0+ (1,0) [0.0|255.0] "" Vector__XXX

BO_ 2 HARDINJ_command2: 8 Vector__XXX
 SG_ HARDINJ_output6Control m0 : 55|8@0+ (1,0) [0.0|255.0] "" Vector__XXX
 SG_ HARDINJ_output5Control m0 : 47|8@0+ (1,0) [0.0|255.0] "" Vector__XXX
 SG_ HARDINJ_output4Control m0 : 39|8@0+ (1,0) [0.0|255.0] "" Vector__XXX
 SG_ HARDINJ_output3Control m0 : 31|8@0+ (1,0) [0.0|255.0] "" Vector__XXX
 SG_ HARDINJ_output2Control m0 : 23|8@0+ (1,0) [0.0|255.0] "" Vector__XXX
 SG_ HARDINJ_output1Control m0 : 15|8@0+ (1,0) [0.0|255.0] "" Vector__XXX
 SG_ HARDINJ_mux M : 7|8@0+ (1,0) [0.0|255.0] "" Vector__XXX

BA_DEF_ BO_  "GenMsgCycleTime" INT 0 65535;
BA_DEF_DEF_  "GenMsgCycleTime" 0;
BA_ "GenMsgCycleTime" BO_ 1 100;
BA_ "GenMsgCycleTime" BO_ 2 100;
