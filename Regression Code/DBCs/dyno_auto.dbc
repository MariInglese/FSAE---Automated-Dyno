VERSION ""

NS_ :

BS_:

BU_:

BO_ 1792 py_torque: 4 Vector__XXX
 SG_ speed : 16|16@1- (1,0) [0|0] "" Vector__XXX
 SG_ torque : 0|16@1- (1,0) [0|0] "" Vector__XXX

CM_ BO_ 1792 "torque to dyno from pcan";
BA_DEF_  "BusType" STRING ;
BA_DEF_DEF_  "BusType" "CAN";
